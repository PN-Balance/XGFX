/**
 * @file Delay_Port.c
 * @author Pop_Cat (xuzhicheng@longshuo-tech.com)
 * @brief 
 * @version 0.0.0.24.11.08
 * @date 2025年09月22日
 * 
 * 
 */

/* -------------------------------------------------------------------------------------------------------------------------- */
/* 头文件引用 */
/* -------------------------------------------------------------------------------------------------------------------------- */
#include "Delay.h"
#include "MCU.h"

/* -------------------------------------------------------------------------------------------------------------------------- */
/* 私有宏定义 */
/* -------------------------------------------------------------------------------------------------------------------------- */
#define DELAY_TIM   TIM16
#define DELAY_TIM_CLOCK_ENABLE LL_APB1_GRP2_EnableClock( LL_APB1_GRP2_PERIPH_TIM16 )
/* -------------------------------------------------------------------------------------------------------------------------- */
/* 内部函数声明 */
/* -------------------------------------------------------------------------------------------------------------------------- */


/* -------------------------------------------------------------------------------------------------------------------------- */
/* 私有类型定义 */
/* -------------------------------------------------------------------------------------------------------------------------- */

/* -------------------------------------------------------------------------------------------------------------------------- */
/* 外部变量引用声明 */
/* -------------------------------------------------------------------------------------------------------------------------- */


/* -------------------------------------------------------------------------------------------------------------------------- */
/* 文件作用域对象 */
/* -------------------------------------------------------------------------------------------------------------------------- */


/* -------------------------------------------------------------------------------------------------------------------------- */
/* 只读数据 */
/* -------------------------------------------------------------------------------------------------------------------------- */


/* -------------------------------------------------------------------------------------------------------------------------- */
/* 函数定义 */
/* -------------------------------------------------------------------------------------------------------------------------- */
/**
 * @brief 初始化用于延时的定时器
 * @note 此函数配置定时器6作为延时功能的基础定时器
 */
void Delay_Port_Timer_Init( void )
{
    LL_TIM_InitTypeDef TIM_CountInit = {0};
    
    /* Enable TIM clock */
    DELAY_TIM_CLOCK_ENABLE;
    
    /* 1US */
    TIM_CountInit.ClockDivision       = LL_TIM_CLOCKDIVISION_DIV1;/* No clock division */
    TIM_CountInit.CounterMode         = LL_TIM_COUNTERMODE_UP;    /* Up counting mode */
    TIM_CountInit.Prescaler           = 72 - 1;                  /* Prescaler：72 */
    TIM_CountInit.Autoreload          = 0xFFFFFFFF;              /* Max Autoreload value */
    TIM_CountInit.RepetitionCounter   = 0;                       /* RepetitionCounter value：0 */
    
    /* Initialize TIM */
    if (LL_TIM_Init( DELAY_TIM, &TIM_CountInit) != SUCCESS) {
        /* Error handling */
        while(1);  /* 初始化失败，进入死循环 */
    }

    /* Clear update flag */
    LL_TIM_ClearFlag_UPDATE( DELAY_TIM );
    
    LL_TIM_EnableIT_UPDATE( DELAY_TIM );
    LL_TIM_DisableCounter( DELAY_TIM );
    LL_TIM_ClearFlag_UPDATE( DELAY_TIM );
}


/**
 * @brief 微秒级延时函数
 * @param us 延时的微秒数
 * @note 该函数通过配置定时器来实现微秒级的精确延时
 */
void Delay_Port_Delay_us( uint32_t us )
{
    if( !us ) return;

    /* Disable counter, clear update flag, reset counter, set auto-reload value */
    LL_TIM_DisableCounter( DELAY_TIM );        // 关闭定时器，为配置做准备
    LL_TIM_ClearFlag_UPDATE( DELAY_TIM );      // 清除更新标志位，确保定时器状态正确
    LL_TIM_SetCounter( DELAY_TIM , 0 );        // 清零计数器
    LL_TIM_SetAutoReload( DELAY_TIM , us );    // 设置自动重载值为延时时间
    LL_TIM_ClearFlag_UPDATE( DELAY_TIM );      // 清除更新标志位，确保定时器状态正确
    LL_TIM_EnableCounter( DELAY_TIM );        // 启动定时器开始计数

    // 等待定时器更新标志位被置位，表示延时完成
    while( !LL_TIM_IsActiveFlag_UPDATE( DELAY_TIM ) ) {
        // 可以添加超时处理
    }
    
}
